## meta-config-pi/conf/distro/flutterpi.conf
```bitbake
DISTRO = "flutterpi"
DISTRO_NAME = "Flutter-pi (Yocto Project Reference Distro)"
DISTRO_VERSION = "1.0"
DISTRO_CODENAME = "honister"
SDK_VENDOR = "-pokysdk"
SDK_VERSION = "${@d.getVar('DISTRO_VERSION').replace('snapshot-${METADATA_REVISION}', 'snapshot')}"
SDK_VERSION[vardepvalue] = "${SDK_VERSION}"

MAINTAINER = "Poky <poky@lists.yoctoproject.org>"

INHERIT:append = " rm_work"

BBMASK = "meta-networking/recipes-kernel/wireguard"

DISTRO_FEATURES:remove = "sysvinit x11"
DISTRO_FEATURES:append = " alsa bluetooth usbhost opengl vulkan wayland pam systemd"
# DISTRO_FEATURES:append = " pam selinux"

INIT_MANAGER = "systemd"
VIRTUAL-RUNTIME:init_manager = "systemd"
VIRTUAL-RUNTIME:initscripts = ""

DISTRO_FEATURES_BACKFILL_CONSIDERED = ""

COMBINED_FEATURES += "alsa "
MACHINE_FEATURES:remove = "apm"

LINUX_KERNEL_TYPE = "preempt-rt"
PREFERRED_VERSION:linux-raspberrypi = "5.10.%"
# CMDLINE_DEBUG = "quiet"

GPU_MEM = "256"
DISPMANX_OFFLINE = "1"
DISABLE_OVERSCAN = "1"

DISABLE_RPI_BOOT_LOGO = "1"
DISABLE_SPLASH = "1"

# ENABLE_SPI_BUS = "0"

# ENABLE_I2C = "0"
# KERNEL_MODULE_AUTOLOAD:rpi += "i2c-dev i2c-bcm2708"

ENABLE_UART = "0"
# SERIAL_CONSOLES = "115200;ttyAMA0"

CORE_IMAGE_EXTRA_INSTALL += " \
    avahi-daemon \
    kernel-modules \
    userland \
    vulkan-loader vulkan-tools \
    openssh openssh-keygen openssh-sftp-server \
    ntp ntp-tickadj \
    packagegroup-core-boot \
    procps \
    tzdata \
    bluez5 \
    bluez5-dev \
    bluez5-noinst-tools \
    bluez5-obex \
    bluez5-testtools \
    bluealsa \
    python3-pybluez \
    alsa-lib \
    alsa-conf \
    alsa-state \
    alsa-utils \
    alsa-utils-scripts \
    canutils \
    nmap \
    gstreamer1.0 \
    gstreamer1.0-libav \
    gstreamer1.0-meta-base \
    gstreamer1.0-omx \
    gstreamer1.0-plugins-bad \
    gstreamer1.0-plugins-base \
    gstreamer1.0-plugins-base-alsa \
    gstreamer1.0-plugins-good \
    gstreamer1.0-plugins-ugly \
    x264 \
    checksec \
    nikto \
    crda \
    iw \
    wpa-supplicant \
    adwaita-icon-theme-cursors \
    weston weston-init \
    xdg-user-dirs \
    flutter-pi-release \
    flutter-gallery-release \
    swiftshader \
    vkcube \
    vkquake3 \
    vkrunner \
    vk-layer-perfdoc \
"

LICENSE_FLAGS_WHITELIST += " commercial"

PREFERRED_PROVIDER:jpeg = "libjpeg-turbo"
PREFERRED_PROVIDER:jpeg-native = "libjpeg-turbo-native"

IMAGE_LINGUAS = "es-Es"
PACKAGECONFIG:pn-sascha-samples = "d2d"
PACKAGECONFIG:pn-vkcube = "kms wayland"
PREFERRED_VERSION:vulkan-headers = "1.2.198.0"
PREFERRED_VERSION:vulkan-loader = "1.2.198.1"
PREFERRED_VERSION:vulkan-tools = "1.2.198.0"
PREFERRED_VERSION:glslang = "11.6.0"
PREFERRED_VERSION:vulkan-validationlayers = "1.2.198"
PREFERRED_VERSION:cmake = "3.21.1"
PREFERRED_VERSION:cmake-native = "3.21.1"
```

## meta-config-pi/conf/distro/include/config-file.conf
```bitbake
# Settings set in config.txt file
# This is an important file for tuning RPI

CMDLINE_DEBUG = "quiet"

GPU_MEM = "256"

DISPMANX_OFFLINE = "1"
DISABLE_OVERSCAN = "1"
DISABLE_RPI_BOOT_LOGO = "1"
DISABLE_SPLASH = "1"

# ENABLE_SPI_BUS = "0"
# ENABLE_I2C = "0"
ENABLE_UART = "0"
# SERIAL_CONSOLES = "115200;ttyAMA0"

# KERNEL_MODULE_AUTOLOAD:rpi += "i2c-dev i2c-bcm2708"

HDMI_FORCE_HOTPLUG = "1"
CONFIG_HDMI_BOOST = "7"
HDMI_GROUP = "2"
HDMI_MODE = "87"
HDMI_DRIVE = "1"
DISPLAY_ROTATE = "0"
HDMI_CVT = "800 480 60 6 0 0 0"
```

## meta-config-pi/conf/distro/include/versions.conf
```bitbake
# List of preferred versions

PREFERRED_VERSION:linux-raspberrypi = "5.10.%"
PREFERRED_PROVIDER:jpeg = "libjpeg-turbo"
PREFERRED_PROVIDER:jpeg-native = "libjpeg-turbo-native"
PREFERRED_VERSION:vulkan-headers = "1.2.198.0"
PREFERRED_VERSION:vulkan-loader = "1.2.198.1"
PREFERRED_VERSION:vulkan-tools = "1.2.198.0"
PREFERRED_VERSION:glslang = "11.6.0"
PREFERRED_VERSION:vulkan-validationlayers = "1.2.198"
PREFERRED_VERSION:cmake = "3.21.1"
PREFERRED_VERSION:cmake-native = "3.21.1"
```

## meta-config-pi/conf/layer.conf
```bitbake
# We have a conf and classes directory, append to BBPATH
BBPATH .= ":${LAYERDIR}"

# We have a recipes directory containing .bb and .bbappend files, add to BBFILES
BBFILES += "${LAYERDIR}/recipes*/*/*.bb \
            ${LAYERDIR}/recipes*/*/*.bbappend"

BBFILE_COLLECTIONS += "config-pi"
BBFILE_PATTERN_config-pi := "^${LAYERDIR}/"
BBFILE_PRIORITY_config-pi = "9"

LAYERSERIES_COMPAT_config-pi = "kirkstone"
LAYERDEPENDS_config-pi = "raspberrypi"

# Additional license directories.
#LICENSE_PATH += "${LAYERDIR}/files/custom-licenses"
```

## meta-flutter-app/conf/layer.conf
```bitbake
# We have a conf and classes directory, append to BBPATH
BBPATH .= ":${LAYERDIR}"

# We have a recipes directory containing .bb and .bbappend files, add to BBFILES
BBFILES += "${LAYERDIR}/recipes*/*/*.bb \
            ${LAYERDIR}/recipes*/*/*.bbappend"

BBFILE_COLLECTIONS += "flutter-app"
BBFILE_PATTERN_flutter-app := "^${LAYERDIR}/"
BBFILE_PRIORITY_flutter-app = "9"

LAYERSERIES_COMPAT_flutter-app = "honister"
LAYERDEPENDS_flutter-app = "meta-flutter"

# Additional license directories.
#LICENSE_PATH += "${LAYERDIR}/files/custom-licenses"
```
